## firmware/tests/packet/testcase.yaml
```yaml
tests:
  hs.packet:
    platform_allow:
      - native_sim/native/64
      - nrf52840dk/nrf52840
    integration_platforms:
      - native_sim/native/64
    tags: hs
```
